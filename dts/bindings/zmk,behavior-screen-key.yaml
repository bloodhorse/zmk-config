## dts/bindings/zmk,behavior-screen-key.yaml
```yaml
description: A key the central forwards to the peripheral's OLED (oled/fw/behavior_screen_key.c)

compatible: "zmk,behavior-screen-key"

include: zero_param.yaml
```

## dts/bindings/zmk,behavior-screen-next.yaml
```yaml
description: The next pattern on one half's OLED (oled/fw/screen.c)

compatible: "zmk,behavior-screen-next"

include: zero_param.yaml

properties:
  side:
    type: int
    required: true
    description: 0 the left half (central), 1 the right
```
